## config/west.yml
```yaml
manifest:
  remotes:
    - name: zmkfirmware
      url-base: https://github.com/zmkfirmware
    - name: ludwig-xu
      url-base: https://github.com/ludwig-xu
    - name: eyelash
      url-base: https://github.com/a741725193
  projects:
    - name: zmk
      remote: zmkfirmware
      revision: v0.3.0
      import: app/west.yml
    - name: edit-oled
      remote: ludwig-xu
      revision: main
    - name: zmk-board-eyelash
      remote: eyelash
      revision: main
  self:
    path: config
```
